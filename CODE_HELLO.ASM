;DAU BAI:
;NEU BAM NUT THI TX: HELLO SV TNUT
;NEU NHAN DC: 1 THI BAT DEN 1  ; 4 THI TAT
;NEU NHAN DC: 2 THI BAT DEN 2  ; 5 THI TAT
;NEU NHAN DC: 3 THI BAT DEN 3  ; 6 THI TAT
;NEU NHAN DC: A THI BAT CA 3 DEN
;NEU NHAN DC: T THI TAT CA 3 DEN

NUT  BIT P2.7
LED1 BIT P2.0
LED2 BIT P2.1
LED3 BIT P2.2
	
ORG 0
	CLR LED1
	CLR LED2
	CLR LED3  ; BAN DAU 3 LED DEU TAT
	
	MOV TMOD,#20H    ; TIME1 MODE 2 (AUTO RELOAD)
	MOV TH1, #0FDH	 ; FDH <==> 9600 BPS
	SETB TR1		 ; START TIMER1
	MOV SCON, #50H   ; UART ENABLE TX, RX
	;MOV SCON, #40H   ; UART ENABLE TX, DISABLE RX
	MAIN:
		ACALL CHECK_NUT_BAM  ; NEU BAM THI TRUYEN HELLO SV TNUT 
		
		ACALL CHECK_RX_DATA
		
		
	JMP MAIN
	
	CHECK_RX_DATA:
		;NHAN 1 KITU VE
		CLR RI   ; RI==FLAG BAO NHAN DU LIEU
				 ;RI AUTO 1 KHI CO DU LIEU TRUYEN DEN
		DOI_NHAN_XONG:
			ACALL CHECK_NUT_BAM
		JNB RI, DOI_NHAN_XONG
		
		MOV A, SBUF    ; KI TU NHAN DC TRONG SBUF
		
		;DIEU KHIEN THEO KI TU NHAN DC
		CJNE A,#'T',KO_PHAI_T
			CLR LED1
			CLR LED2
			CLR LED3
		KO_PHAI_T:
		
		CJNE A,#'A',KO_PHAI_A
			SETB LED1
			SETB LED2
			SETB LED3
		KO_PHAI_A:
		
		CJNE A,#'1',KO_PHAI_1
			SETB LED1			
		KO_PHAI_1:
		
		CJNE A,#'4',KO_PHAI_4
			CLR LED1
		KO_PHAI_4:
		
		CJNE A,#'2',KO_PHAI_2
			SETB LED2			
		KO_PHAI_2:
		
		CJNE A,#'5',KO_PHAI_5
			CLR LED2
		KO_PHAI_5:
		
		CJNE A,#'3',KO_PHAI_3
			SETB LED3			
		KO_PHAI_3:
		
		CJNE A,#'6',KO_PHAI_6
			CLR LED3
		KO_PHAI_6:
		
		CJNE A,#'0',KO_PHAI_0
			SETB LED1
			CLR  LED2
			SETB LED3
		KO_PHAI_0:
	RET
	
	CHECK_NUT_BAM:
		JB NUT, NUT_KO_BAM
			;CAN TRUYEN DI CHUOI HELLO
			MOV DPTR,#HELLO
			MOV R0,#0  ; VI TRI KI TU SE TRUYEN
			TRUYEN_1_CHAR:
				MOV  A,R0		; LAY VI TRI
				MOVC A,@A+DPTR  ; LAY KI TU TAI VI TRI R0
				JZ   TRUYEN_XONG
				MOV  SBUF, A    ; SERIAL BUFFER
				CLR  TI         ; TI: FLAG ENABLE SEND
				;TI AUTO==1 KHI TRUYEN XONG
				JNB  TI,$       ; DOI TRUYEN XONG
				INC R0			; NEXT CHAR
			JMP TRUYEN_1_CHAR
			TRUYEN_XONG:
			JNB NUT,$    ; DOI NHA NUT
		NUT_KO_BAM:
	RET
	
	HELLO: DB "HELLO SV TNUT",13,0
END